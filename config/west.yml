## config/west.yml
```yaml
manifest:
  remotes:
    - name: urob
      url-base: https://github.com/urob
    - name: m165437
      url-base: https://github.com/M165437
    - name: joelspadin
      url-base: https://github.com/joelspadin
  projects:
    - name: zmk
      remote: urob
      revision: main
      import: app/west.yml
    - name: nice-view-gem
      remote: m165437
      revision: main
    - name: zmk-helpers
      remote: urob
      revision: main
  self:
    path: config
```
